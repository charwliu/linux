// SPDX-License-Identifier: (GPL-2.0+ OR MIT)

/dts-v1/;

#include "rk3588s-nanopi-r6.dtsi"

/ {
	model = "FriendlyElec NanoPi R6C";
	compatible = "friendlyarm,nanopi-r6c", "rockchip,rk3588s";

	aliases {
		ethernet0 = &r8125_u25;
		ethernet1 = &gmac1;
	};
};

&lan2_led {
	label = "user_led";
};

&pcie2x1l2 {
	/delete-node/ pcie40@0,0;
};
